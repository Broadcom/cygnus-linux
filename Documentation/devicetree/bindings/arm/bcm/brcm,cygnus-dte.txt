## Documentation/devicetree/bindings/arm/bcm/brcm,cygnus-dte.txt
```
Broadcom Cygnus DTE Digital Timing Engine device tree bindings

The DTE block allows for hardware timestamping of network packets,
audio/video samples and/or GPIO inputs in a common adjustable time base.

Required SoC Specific Properties:
- compatible: should be "brcm,cygnus-dte"

- reg: Requires two separate register sets
	Base address of the Audio EAV Regsiters for DTE block and length of memory
	mapped region.

- interrupts: The DTE interrupt number to the cpu.

Example:

/ {
	dte: dte@0x180af000 {
		compatible = "brcm,cygnus-dte";
		reg = <0x180af000 0x1000>;
		interrupts = <GIC_SPI 144 IRQ_TYPE_LEVEL_HIGH>;

	};
};
```

## Documentation/devicetree/bindings/arm/bcm/brcm,nsp-cpu-method.txt
```
Broadcom Northstar Plus SoC CPU Enable Method
---------------------------------------------
This binding defines the enable method used for starting secondary
CPUs in the following Broadcom SoCs:
  BCM58522, BCM58525, BCM58535, BCM58622, BCM58623, BCM58625, BCM88312

The enable method is specified by defining the following required
properties in the "cpus" device tree node:
  - enable-method = "brcm,bcm-nsp-smp";
  - secondary-boot-reg = <...>;

The secondary-boot-reg property is a u32 value that specifies the
physical address of the register used to request the ROM holding pen
code release a secondary CPU.

Example:
	cpus {
		#address-cells = <1>;
		#size-cells = <0>;
		enable-method = "brcm,bcm-nsp-smp";
		secondary-boot-reg = <0xffff042c>;

		cpu0: cpu@0 {
			device_type = "cpu";
			compatible = "arm,cortex-a9";
			next-level-cache = <&L2>;
			reg = <0>;
		};

		cpu1: cpu@1 {
			device_type = "cpu";
			compatible = "arm,cortex-a9";
			next-level-cache = <&L2>;
			reg = <1>;
		};
	};
```

## Documentation/devicetree/bindings/gpio/brcm,cygnus-gpio.txt
```
Broadcom Cygnus GPIO Controller

Required properties:

- compatible:
    Must be "brcm,cygnus-gpio"

- reg:
    Define the base and range of the I/O address space that contain the Cygnus
GPIO controller registers

- ngpios:
    Total number of GPIOs the controller provides

- #gpio-cells:
    Must be two. The first cell is the GPIO pin number (within the
controller's domain) and the second cell is used for the following:
    bit[0]: polarity (0 for normal and 1 for inverted)
    bit[18:16]: internal pull up/down: 0 - pull up/down disabled
                                       1 - pull up enabled
                                       2 - pull down enabled
    bit[22:20]: drive strength: 0 - 2 mA
                                1 - 4 mA
                                2 - 6 mA
                                3 - 8 mA
                                4 - 10 mA
                                5 - 12 mA
                                6 - 14 mA
                                7 - 16 mA

- gpio-controller:
    Specifies that the node is a GPIO controller

Optional properties:

- interrupt-controller:
    Specifies that the node is an interrupt controller. Not all Cygnus GPIO
interfaces support interrupt, e.g., the CRMU GPIO controller does not have its
interrupt routed to the main processor's GIC

- interrupts:
    The interrupt outputs from the GPIO controller.

- no-drv-strength:
    Specifies the GPIO controller does not support drive strength configuration

Example:
	gpio_asiu: gpio@180a5000 {
		compatible = "brcm,cygnus-gpio";
		reg = <0x180a5000 0x668>;
		ngpios = <122>;
		#gpio-cells = <2>;
		gpio-controller;
		interrupt-controller;
		interrupts = <GIC_SPI 174 IRQ_TYPE_LEVEL_HIGH>;
	};

	gpio_crmu: gpio@03024800 {
		compatible = "brcm,cygnus-gpio";
		reg = <0x03024800 0x50>;
		ngpios = <6>;
		#gpio-cells = <2>;
		gpio-controller;
		no-drv-strength;
	};

	/*
	 * Touchscreen that uses the ASIU GPIO 100, with internal pull-up
	 * enabled
	 */
	tsc {
		...
		...
		gpio-event = <&gpio_asiu 100 0x10000>;
	};

	/* Bluetooth that uses the CRMU GPIO 2, with polarity inverted */
	bluetooth {
		...
		...
		bcm,rfkill-bank-sel = <&gpio_crmu 2 1>
	}
```

## Documentation/devicetree/bindings/input/touchscreen/brcm,iproc-touchscreen.txt
```
* Broadcom's IPROC Touchscreen Controller

Required properties:
- compatible: must be "brcm,iproc-touchscreen"
- reg: physical base address of the controller and length of memory mapped
  region.
- clocks:  The clock provided by the SOC to driver the tsc
- clock-name:  name for the clock
- interrupts: The touchscreen controller's interrupt

Optional properties:
- scanning_period: Time between scans. Each step is 1024 us.  Valid 1-256.
- debounce_timeout: Each step is 512 us.  Valid 0-255
- settling_timeout: The settling duration (in ms) is the amount of time
                    the tsc waits to allow the voltage to settle after
                    turning on the drivers in detection mode.
                    Valid values: 0-11
                    0 =  0.008 ms
                    1 =  0.01 ms
                    2 =  0.02 ms
                    3 =  0.04 ms
                    4 =  0.08 ms
                    5 =  0.16 ms
                    6 =  0.32 ms
                    7 =  0.64 ms
                    8 =  1.28 ms
                    9 =  2.56 ms
                   10 =  5.12 ms
                   11 = 10.24 ms
- touch_timeout: The continuous number of scan periods in which touch is
                not detected before the controller returns to idle state.
                Valid values 0-255.
- average_data: Number of data samples which are averaged before a final
                data point is placed into the FIFO
                Valid values 0-7
                0 =   1 sample
                1 =   2 samples
                2 =   4 samples
                3 =   8 samples
                4 =  16 samples
                5 =  32 samples
                6 =  64 samples
                7 = 128 samples
- fifo_threshold: Interrupt is generated whenever the number of fifo
                entries exceeds this value
                Valid values 0-31
- ts-rotation: Touch screen controller and display panel orientation angle.
		0 = Tsc x_min y_min placed at LCD x_min y_min. None
		1 = Tsc x_min y_max placed at LCD x_min y_min. 90 degrees
		2 = Tsc x_max y_max placed at LCD x_min y_min. 180 degrees
		3 = Tsc x_max y_min placed at LCD x_min y_min. 270 degrees
Example:

	touchscreen: tsc@0x180A6000 {
		compatible = "brcm,iproc-touchscreen";
		#address-cells = <1>;
		#size-cells = <1>;
		reg = <0x180A6000 0x40>;
		clocks = <&adc_clk>;
		clock-names = "tsc_clk";
		interrupts = <GIC_SPI 164 IRQ_TYPE_LEVEL_HIGH>;

		scanning_period = <5>;
		debounce_timeout = <40>;
		settling_timeout = <7>;
		touch_timeout = <10>;
		average_data = <5>;
		fifo_threshold = <1>;
		ts-rotation = <2>;
	};
```

## Documentation/devicetree/bindings/mailbox/brcm,iproc-mailbox.txt
```
* Broadcom's iProc Mailbox Controller

Broadcom iProc architected SoC's have an always on Cortex-M0 MCU processor that
handles support for power, clock, and reset management. The iProc mailbox
controller handles all communication with this processor.

Required properties:
- compatible: Must be "brcm,iproc-mailbox"
- reg: Defines the base address of the mailbox controller.
- #mbox-cells: Must be 1.

Example:

	mailbox: mailbox@3024024 {
		compatible = "brcm,iproc-mailbox";
		reg = <0x03024024 0x8>;
		#mbox-cells = <1>;
	};
```

## Documentation/devicetree/bindings/mtd/brcm,iproc-nand-cygnus.txt
```
IPROC NAND controller

Required properties:
  - compatible : Should be "brcm,iproc-nand-nsp" or "brcm,iproc-nand-cygnus".
  - reg : The registers location and length for nand_regs, nand_idm_regs and
	  optionally nand_strap_regs.
  - interrupts : The interrupt number.

Optional properties:
- #chip-selects : Number of chip selects. If not present, it defaults to 1.
- wp-mode : Write protect mode. If not present, it defaults to 1.
		0 - WP is not used or not available
		1 - WP is set by default, cleared for erase/write operations
		2 - WP is always cleared
- timing-mode : Maximum ONFI timing mode allowed (0-5).
		If not present, it defaults to power-on timing configuration
- hw-auto-init : Perform controller auto configuration
- corr-threshold-percent : The percentage of the BCH ECC correction capability
			   from which correctable errors will be reported.
			   If not present, it defaults to 60%.

Examples:

	nand: nand@0x18046000 {
		compatible = "brcm,iproc-nand-cygnus";
		reg = nand_regs: <0x18046000 0x1000>,
		      nand_idm_regs: <0xf8105000 0x1000>;
		interrupts = <GIC_SPI 69 IRQ_TYPE_LEVEL_HIGH>;
		#chip-selects = <1>;
		wp-mode = <1>;
		timing-mode = <5>;
	};
```

## Documentation/devicetree/bindings/net/brcm,mdio-mux-nsp.txt
```
Properties for an MDIO bus multiplexer available in Broadcom NSP SoC.

This MDIO bus multiplexer defines buses that could access the internal
phys as well as external to SoCs. When child bus is selected, one needs
to select the below properties to generate desired MDIO transaction on
appropriate bus.

Required properties in addition to the generic multiplexer properties:

MDIO multiplexer node:
- compatible: brcm,mdio-mux-iproc.
- reg: Should contain registers location and length.
- reg-names: Should contain the resource reg names.
	- bus-ctrl: mdio bus control register address space required to
	  select the bus master. This property is not required for SoC's
	  that doesn't provide master selection.
	- mgmt-ctrl: mdio management control register address space

Sub-nodes:
   Each bus master should be represented as a sub-node.

Sub-nodes required properties:
- reg: Bus master number. Should be 0x10 to access the external mdio devices.
- address-cells: should be 1
- size-cells: should be 0

Every non-ethernet PHY requires a compatible property so that it could be
probed based on this compatible string.

Additional information regarding generic multiplexer properties can be found
at- Documentation/devicetree/bindings/net/mdio-mux.txt

example:

	mdio_mux: mdio-mux@3f190 {
		compatible = "brcm,mdio-mux-nsp";
		reg = <0x3f190 0x4>,
		      <0x32000 0x4>;
		reg-names = "bus-ctrl", "mgmt-ctrl";
		mdio-parent-bus = <&mdio>;
		#address-cells = <1>;
		#size-cells = <0>;

		mdio@0 {
			reg = <0x0>;
			#address-cells = <1>;
			#size-cells = <0>;

			usb3_phy: usb3-phy@10 {
				compatible = "brcm,nsp-usb3-phy";
				reg = <0x10>;
				usb3-ctrl-syscon = <&usb3_ctrl>;
				#phy-cells = <0>;
				status = "disabled";
			};
		};
	};
```

## Documentation/devicetree/bindings/pci/brcm,iproc-pcie.txt
```
* Broadcom iProc PCIe controller

Required properties:
- compatible: Must be "brcm,iproc-pcie"
- reg: base address and length of the PCIe controller and the MDIO interface
  that controls the PCIe PHY
- #interrupt-cells: set to <1>
- interrupts: interrupt IDs
- interrupt-map-mask and interrupt-map, standard PCI properties to define the
  mapping of the PCIe interface to interrupt numbers
- bus-range: PCI bus numbers covered
- #address-cells: set to <3>
- #size-cells: set to <2>
- device_type: set to "pci"
- ranges: ranges for the PCI memory and I/O regions
- phy-addr: MDC/MDIO adddress of the PCIe PHY
- have-msi-inten-reg: Required for legacy iProc PCIe controllers that need the
  MSI interrupt enable register to be set explicitly

The Broadcom iProc PCie driver adapts the multi-domain structure, i.e., each
interface has its own domain and therefore has its own device node
Example:

SoC specific DT Entry:

	pcie0: pcie@18012000 {
		compatible = "brcm,iproc-pcie";
		reg = <0x18012000 0x1000>,
			<0x18002000 0x1000>;

		#interrupt-cells = <1>;
		interrupts = <GIC_SPI 96 IRQ_TYPE_NONE>,
			     <GIC_SPI 97 IRQ_TYPE_NONE>,
			     <GIC_SPI 98 IRQ_TYPE_NONE>,
			     <GIC_SPI 99 IRQ_TYPE_NONE>,
			     <GIC_SPI 100 IRQ_TYPE_NONE>,
			     <GIC_SPI 101 IRQ_TYPE_NONE>;
		interrupt-map-mask = <0 0 0 0>;
		interrupt-map = <0 0 0 0 &gic GIC_SPI 100 IRQ_TYPE_NONE>;

		bus-range = <0x00 0xFF>;

		#address-cells = <3>;
		#size-cells = <2>;
		device_type = "pci";
		ranges = <0x81000000 0 0	  0x28000000 0 0x00010000   /* downstream I/O */
			  0x82000000 0 0x20000000 0x20000000 0 0x04000000>; /* non-prefetchable memory */
		phy-addr = <5>;
	};

	pcie1: pcie@18013000 {
		compatible = "brcm,iproc-pcie";
		reg = <0x18013000 0x1000>,
			<0x18002000 0x1000>;

		#interrupt-cells = <1>;
		interrupts = <GIC_SPI 102 IRQ_TYPE_NONE>,
			     <GIC_SPI 103 IRQ_TYPE_NONE>,
			     <GIC_SPI 104 IRQ_TYPE_NONE>,
			     <GIC_SPI 105 IRQ_TYPE_NONE>,
			     <GIC_SPI 106 IRQ_TYPE_NONE>,
			     <GIC_SPI 107 IRQ_TYPE_NONE>;
		interrupt-map-mask = <0 0 0 0>;
		interrupt-map = <0 0 0 0 &gic GIC_SPI 106 IRQ_TYPE_NONE>;

		bus-range = <0x00 0xFF>;

		#address-cells = <3>;
		#size-cells = <2>;
		device_type = "pci";
		ranges = <0x81000000 0 0	  0x48000000 0 0x00010000   /* downstream I/O */
			  0x82000000 0 0x40000000 0x40000000 0 0x04000000>; /* non-prefetchable memory */
		phy-addr = <6>;
	};
```

## Documentation/devicetree/bindings/phy/brcm,cygnus-pcie-phy.txt
```
Broadcom Cygnus PCIe PHY

Required properties:
- compatible: Must be "brcm,cygnus-pcie-phy"
- reg: base address and length of the PCIe PHY block
- #phy-cells: must be <1>
The first cell is the PHY ID:
0 - PCIe RC 0
1 - PCIe RC 1

Example:
	pcie_phy: phy@0301d0a0 {
		compatible = "brcm,cygnus-pcie-phy";
		reg = <0x0301d0a0 0x14>;
		#phy-cells = <1>;
	};

	pcie0: pcie@18012000 {
		...
		...
		phys = <&pcie_phy 0>;
		phy-names = "pcie-phy";
	};

	pcie1: pcie@18013000 {
		...
		...
		phys = <&pcie_phy 1>;
		phy-names = "pcie-phy";
	};
```

## Documentation/devicetree/bindings/phy/brcm,cygnus-usb-phy.txt
```
BROADCOM CYGNUS USB PHY

Required Properties:
	- compatible:  brcm,cygnus-usb-phy
	- reg : usbphy_regs - Base address of phy registers
			usb2h_idm_regs - Base address of host idm registers
			usb2d_idm_regs - Base address of device idm registers
	- phy-cells - must be 1 for each port declared. The node
		      that uses the phy must provide either PHY_CONFIG_DEVICE for device
		      or PHY_CONFIG_HOST for host

NOTE: port 0 and port 1 are host only and port 2 can be configured for host or
device.

Example of phy :
	usbphy0: usbphy@0x0301c000 {
		compatible = "brcm,cygnus-usb-phy";
		reg = <0x0301c000 0x2000>,
		      <0x18115000 0x1000>,
		      <0x18111000 0x1000>;
		status = "okay";

		#address-cells = <1>;
		#size-cells = <0>;
		usbphy0_0: usbphy0@0 {
			#phy-cells = <1>;
			reg = <0>;
			status = "okay";
			phy-supply = <&vbus_p0>;
		};

		usbphy0_1: usbphy0@1 {
			#phy-cells = <1>;
			reg = <1>;
			status = "okay";
		};

		usbphy0_2: usbphy0@2 {
			#phy-cells = <1>;
			reg = <2>;
			status = "okay";
			phy-supply = <&vbus_p2>;
		};
	};

Example of node using the phy:

	/* This nodes declares all three ports as host */

	ehci0: usb@0x18048000 {
		compatible = "generic-ehci";
		reg = <0x18048000 0x100>;
		interrupts = <GIC_SPI 72 IRQ_TYPE_LEVEL_HIGH>;
		phys = <&usbphy0_0 PHY_CONFIG_HOST &usbphy0_1 PHY_CONFIG_HOST &usbphy0_2 PHY_CONFIG_HOST>;
		status = "okay";
	};

	/*
	 * This node declares port 2 phy
	 * and configures it for device
	 */

	usbd_udc_dwc1: usbd_udc_dwc@0x1804c000 {
		compatible = "iproc-udc";
		reg = <0x1804c000 0x2000>;
		interrupts = <GIC_SPI 123 IRQ_TYPE_LEVEL_HIGH>;
		phys = <&usbphy0_2 PHY_CONFIG_DEVICE>;
		phy-names = "usb";
	};
```

## Documentation/devicetree/bindings/phy/brcm,iproc-mdio.txt
```
Broadcom iProc MDC/MDIO interface

The iProc MDC/MDIO interface is found on various iProc based SoCs and used to
communicate with various types of Serdes/PHYs including Ethernet, PCIe, USB,
and etc.

Required properties:
- compatible: Must be "brcm,iproc-mdio"
- reg: base address and length of the MDC/MDIO block

Example:
	mdio: mdio@18002000 {
		compatible = "brcm,iproc-mdio";
		reg = <0x18002000 0x8>;
	};
```

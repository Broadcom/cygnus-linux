## Documentation/devicetree/bindings/phy/brcm,nsp-usb3-phy.txt
```
Broadcom USB3 phy binding northstar plus SoC
This is a child bus node of "brcm,mdio-mux-nsp" node.

Required mdio bus properties:
- reg: MDIO Bus number for the MDIO interface
- #address-cells: must be 1
- #size-cells: must be 0

Required PHY properties:
- compatible: should be "brcm,nsp-usb3-phy"
- reg: Phy address in the MDIO interface
- usb3-ctrl-syscon: handler of syscon node defining physical address
  of usb3 control register.
- #phy-cells: must be 0

Required usb3 control properties:
- compatible: should be "brcm,nsp-usb3-ctrl"
- reg: offset and length of the control registers

Example:

	mdio@0 {
		reg = <0x0>;
		#address-cells = <1>;
		#size-cells = <0>;

		usb3_phy: usb3-phy@10 {
			compatible = "brcm,nsp-usb3-phy";
			reg = <0x10>;
			usb3-ctrl-syscon = <&usb3_ctrl>;
			#phy-cells = <0>;
			status = "disabled";
		};
	}

	usb3_ctrl: syscon@104408 {
		compatible = "brcm,nsp-usb3-ctrl", "syscon";
		reg = <0x104408 0x3fc>;
	};
```

## Documentation/devicetree/bindings/pinctrl/brcm,cygnus-pinctrl.txt
```
Broadcom Cygnus Pin Controller

The Cygnus pin controller supports setting the alternate functions of groups
of pins. Pinmux configuration on individual pins is not supported by the
Cygnus A0 SoC.

Required properties:

- compatible:
    Must be "brcm,cygnus-pinctrl"

- reg:
    Define the base and range of the I/O address space that contain the Cygnus
pin control registers

- brcm,groups:
    This can be strings of one or more group names. This defines the group(s)
that one wants to configure

- brcm,function:
    This is the alternate function that one wants to configure to. Valid
alternate functions are "alt1", "alt2", "alt3", "alt4"

Each child node represents a configuration. Client devices reference the the
child node to enable the mux configuration.

For example:

	pinctrl: pinctrl@0x0301d0c8 {
		compatible = "brcm,cygnus-pinctrl";
		reg = <0x0301d0c8 0x2c>;

		i2s_0: i2s_0 {
			brcm,groups = "smart_card0", "smart_card0_fcb";
			brcm,function = "alt2";
		};

		i2s_1: i2s_1 {
			brcm,groups = "smart_card1", "smart_card1_fcb";
			brcm,function = "alt2";
		};

		spi_0: spi_0 {
			brcm,groups = "spi0";
			brcm,function = "alt1";
		};
	}

	spi0@18028000 {
			compatible = "arm,pl022", "arm,primecell";
			reg = <0x18028000 0x1000>;
			#address-cells = <1>;
			#size-cells = <0>;
			interrupts = <GIC_SPI 78 IRQ_TYPE_LEVEL_HIGH>;
			pinctrl-0 = <&spi_0>;
			clocks = <&axi81_clk>;
			clock-names = "apb_pclk";
	};

Consider the following snapshot of Cygnus pinmux table:

number    pin            group              alt1             alt2        alt3        alt4
------    ---            ----               ----             ----        ----        ----
42        sc0_clk        smart_card0        SMART CARD0      I2S_0       N/A         chip_gpio24
43        sc0_cmdvcc_l   smart_card0        SMART CARD0      I2S_0       N/A         STRAP
44        sc0_detect     smart_card0        SMART CARD0      I2S_0       N/A         chip_gpio25
45        sc0_fcb        smart_card0_fcb    SMART CARD0_FCB  I2S_0       N/A         chip_gpio26
46        sc0_io         smart_card0        SMART CARD0      I2S_0       N/A         chip_gpio27
47        sc0_rst_l      smart_card0        SMART CARD0      SPDIF       N/A         STRAP

Note due to limitation of the Cygnus hardware, pinmux configuration can only
be group based. To enable I2S_0 function, one needs the following child node
configuration:

	i2s_0: i2s_0 {
		brcm,groups = "smart_card0", "smart_card0_fcb";
		brcm,function = "alt2";
	};

This tells the Cygnus pin controller to configure groups "smart_card0" and
"smart_card0_fcb" to I2S_0. With this configuration, pins 42, 43, 44, 45, 46
become I2S_0, and pin 47 becomes SPDIF

Consider another example, that one wants to configure the above pins as GPIO:

	gpio_24_27: gpio_24_27 {
		brcm,groups = "smart_card0", "smart_card0_fcb";
		brcm,function = "alt4";
	};

With the above configuration, pins 42, 44, 45, 46 become GPIO, and 43 and 47
become reserved for STRAP
```

## Documentation/devicetree/bindings/sound/brcm,cygnus-audio.txt
```
BROADCOM Cygnus Audio I2S/TDM/SPDIF controller

Required properties:
	- compatible : "brcm,cygnus-audio"
	- #address-cells: 32bit valued, 1 cell.
	- #size-cells:  32bit valued, 0 cell.
	- reg : Should contain audio registers location and length
	- reg-names: names of the registers listed in "reg" property
		Valid names are "aud" and "i2s_in". "aud" contains a
		set of DMA, I2S_OUT and SPDIF registers. "i2s_in" contains
		a set of I2S_IN registers.
	- clocks: PLL and leaf clocks used by audio ports
	- clock-names: names of 3 leaf clocks used by audio ports
		Valid names are "ch0_audio", "ch1_audio", "ch2_audio"
	- interrupts: audio DMA interrupt number

SSP Subnode properties:
- reg: The index of ssp port interface to use
	Valid value are 0, 1, 2, or 3 (for spdif)
- channel-group: Surround sound grouping that controls which channel
  outputs belong to a group, specifically useful in Multi-channel
  Interfaces grouping of serial port. In multi-channel stereo, use
  "2_0", in 3.1 multi-channel grouping, use "3_1" and in 5.1
  multi-channel grouping, use "5_1".


Example:
	cygnus_audio: audio@180ae000 {
		compatible = "brcm,cygnus-audio";
		#address-cells = <1>;
		#size-cells = <0>;
		reg = <0x180ae000 0xafd>, <0x180aec00 0x1f8>;
		reg-names = "aud", "i2s_in";
		clocks = <&audiopll BCM_CYGNUS_AUDIOPLL_CH0>,
				<&audiopll BCM_CYGNUS_AUDIOPLL_CH1>,
				<&audiopll BCM_CYGNUS_AUDIOPLL_CH2>;
		clock-names = "ch0_audio", "ch1_audio", "ch2_audio";
		interrupts = <GIC_SPI 143 IRQ_TYPE_LEVEL_HIGH>;

		ssp0: ssp_port@0 {
			reg = <0>;
			channel-group = "2_0"; /* Use 2_0, 3_1, 5_1 */
			status = "okay";
		};

		ssp1: ssp_port@1 {
			reg = <1>;
			channel-group = "2_0"; /* Use 2_0, 3_1, 5_1 */
			status = "disabled";
		};

		ssp2: ssp_port@2 {
			reg = <2>;
			channel-group = "2_0"; /* Use 2_0, 3_1, 5_1 */
			status = "disabled";
		};

		spdif: spdif_port@3 {
			reg = <3>;
			channel-group = "2_0"; /* Use 2_0, 3_1, 5_1 */
			status = "disabled";
		};
	};
```

## Documentation/devicetree/bindings/spi/brcm,mspi-spi.txt
```
Broadcom MSPI controller

The Broadcom MSPI controller is a SPI controller found on various chips such
as Cygnus.

Required properties:
- compatible: Must be "brcm,mspi-v0".

- reg:  The first register is the physical base address of the MSPI controller.
  The second register is the address of the MSPI interrupt control registers. It
  is only required for chips that have a separate register set for extended
  interrupt control. This is required for Cygnus.

- interrupts: Interrupt ID of the controller.

Optional properties:
- clocks: The MSPI reference clock. If not provided then it is assumed a clock
  is enabled by default and no control of clock-frequency (see below) is
  possible.

- clock-names: The name of the reference clock.

- clock-frequency: Desired frequency of the clock. This will set the serial
  clock baud rate (SPBR) based on the reference clock frequency. The frequency
  of the SPBR is mspi_clk / (2 * SPBR) where SPBR is a value between 1-255
  determined by the desired 'clock-frequency'. If not provided then the default
  baud rate of the controller is used.

Example:

mspi: mspi@18047200 {
	compatible = "brcm,mspi-v0";
	reg = <0x18047200 0x188>,
	      <0x180473a0 0x1c>;
	interrupts = <GIC_SPI 70 IRQ_TYPE_LEVEL_HIGH>;
	clocks = <&axi41_clk>;
	clock-names = "mspi_clk";
	clock-frequency = <12500000>;
};
```
